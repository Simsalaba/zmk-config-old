## config/west.yml
```yaml
manifest:
  remotes:
    - name: zmkfirmware
      url-base: https://github.com/petejohanson/
      
  projects:
    - name: zmk
      remote: petejohanson
      revision: peripheral-behavior-invocation
      import: app/west.yml
  self:
    path: config
```
